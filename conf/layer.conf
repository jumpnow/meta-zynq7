## conf/layer.conf
```bitbake
# We have a conf and classes directory, append to BBPATH
BBPATH .= ":${LAYERDIR}"

# We have a recipes directory, add to BBFILES
BBFILES += "${LAYERDIR}/recipes*/*/*.bb ${LAYERDIR}/recipes*/*/*.bbappend ${LAYERDIR}/images/*.bb"

BBFILE_COLLECTIONS += "meta-zynq7"
BBFILE_PATTERN_meta-zynq7 := "^${LAYERDIR}/"
BBFILE_PRIORITY_meta-zynq7 = "16"

LAYERSERIES_COMPAT_meta-zynq7 = "mickledore"
```

## conf/machine/zc706-zynq7.conf
```bitbake
#@TYPE: Machine
#@NAME: zc706-zynq7
#@DESCRIPTION: Machine configuration for the Xilinx zc706 zynq7 dev board

TARGET_ARCH = "arm"

DEFAULTTUNE = "cortexa9thf-neon"

require conf/machine/include/arm/armv7a/tune-cortexa9.inc

PREFERRED_PROVIDER_virtual/kernel ?= "linux-stable"

PREFERRED_PROVIDER_virtual/bootloader ?= "u-boot"

UBOOT_MACHINE ?= "xilinx_zynq_virt_defconfig"

EXTRA_IMAGEDEPENDS += "u-boot u-boot-scr"

SERIAL_CONSOLES = "115200;ttyPS0"

IMAGE_FSTYPES ?= "tar.gz"

KERNEL_IMAGETYPES ?= "zImage"

MACHINE_ESSENTIAL_EXTRA_RDEPENDS = "kernel-image kernel-devicetree"

MACHINE_FEATURES = "ext2 serial usbhost vfat" 
```
